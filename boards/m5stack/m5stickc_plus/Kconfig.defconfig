## boards/m5stack/m5stickc_plus/Kconfig.defconfig
```kconfig
# M5StickC PLUS board configuration

# Copyright (c) 2022 AVSystem Sławomir Wolf Sp.j. (AVSystem)
# SPDX-License-Identifier: Apache-2.0

if BOARD_M5STICKC_PLUS_ESP32_PROCPU

config GPIO_HOGS_INIT_PRIORITY
	default 70

config MFD_INIT_PRIORITY
	default 70

config REGULATOR_AXP192_AXP2101_INIT_PRIORITY
	default 71

config REGULATOR_FIXED_INIT_PRIORITY
	default 75

endif # BOARD_M5STICKC_PLUS_ESP32_PROCPU
```

## drivers/gpio/Kconfig.axp192
```kconfig
# Copyright (c) 2023 Martin Kiepfer
# SPDX-License-Identifier: Apache-2.0

config GPIO_AXP192
	bool "AXP192 GPIO driver"
	default y
	depends on DT_HAS_X_POWERS_AXP192_GPIO_ENABLED
	depends on DT_HAS_X_POWERS_AXP192_ENABLED
	select I2C
	select MFD
	help
	  Enable the AXP192 GPIO driver.

config GPIO_AXP192_SYS_INIT_GEN
	bool
	default y
	depends on GPIO_AXP192
	depends on MFD_AXP192_SYS_INIT_GEN
	help
	  Enables generation of a SYS_INIT priority for the AXP192 GPIO driver
	  via subsys/sys_init_gen, based on this symbol's Kconfig dependencies.
	  Must be initialized after the AXP192 MFD driver.
```

## drivers/gpio/Kconfig.pcf857x
```kconfig
# PCF857x GPIO configuration options

# Copyright (c) 2022 Ithinx
# Copyright (c) 2023 Mr Beam Lasers GmbH
# Copyright (c) 2023 Amrith Venkat Kesavamoorthi <amrith@mr-beam.org>
# SPDX-License-Identifier: Apache-2.0

menuconfig GPIO_PCF857X
	bool "PCF857X I2C GPIO chip"
	default y
	depends on DT_HAS_NXP_PCF857X_ENABLED
	select I2C
	help
	  Enable driver for PCF857X I2C GPIO chip.

config GPIO_PCF857X_SYS_INIT_GEN
	bool
	default y
	depends on GPIO_PCF857X
	help
	  Enables generation of a SYS_INIT priority for the PCF857X driver via
	  subsys/sys_init_gen, based on this symbol's Kconfig dependencies.
```

## dts/bindings/interrupt-controller/riscv,aplic.yaml
```yaml
# SPDX-FileCopyrightText: Copyright The Zephyr Project Contributors
# SPDX-License-Identifier: Apache-2.0

description: |
  RISC-V Advanced Platform-Level Interrupt Controller (APLIC).

  The APLIC routes wired interrupts in a RISC-V AIA system.  It can operate
  in two delivery modes:

    - MSI mode: interrupts are converted to Message-Signaled Interrupts and
      forwarded to an IMSIC.  Indicated by the presence of 'msi-parent'.
    - Direct delivery mode: interrupts are delivered directly to harts via
      the external interrupt signal.

compatible: "riscv,aplic"

include: [interrupt-controller.yaml, base.yaml]

properties:
  reg:
    required: true
    description: Base address and size of the APLIC registers

  riscv,num-sources:
    type: int
    required: true
    description: Number of interrupt sources supported by the APLIC

  riscv,max-priority:
    type: int
    description: |
      Maximum priority level supported by the APLIC implementation.
      Present on some platforms (e.g., QEMU virt) as well as if direct
      delivery mode is enabled.

  msi-parent:
    type: phandle
    description: |
      Phandle to the IMSIC controller used for MSI delivery.
      When present the driver operates in MSI mode; when absent
      direct delivery mode is assumed.

  riscv,children:
    type: phandles
    description: |
      Child APLIC domains of this domain. The position of a child in this
      list is its child index in the sourcecfg registers of this domain.

  riscv,delegation:
    type: phandle-array
    specifier-space: aplic-delegation
    description: |
      Interrupt sources delegated to child domains at initialization. Each
      entry is a child domain phandle followed by the first and last source
      number of the delegated range in this domain. Every child domain
      referenced here must be listed in riscv,children and have
      #aplic-delegation-cells = <2>.

  "#aplic-delegation-cells":
    type: int
    const: 2
    description: |
      Number of cells in a riscv,delegation specifier. Required in child
      domains that a parent delegates sources to.

interrupt-cells:
  - irq
  - priority
  - flags

aplic-delegation-cells:
  - first-source
  - last-source
```

## subsys/sys_init_gen/Kconfig
```kconfig
config SYS_INIT_GEN_APPLICATION_PRE
	int
	default 40
	help
	    Represents priority preceeding the range used by sys_init generation at APPLICATION level

config SYS_INIT_GEN_APPLICATION_POST
	int
	default 60
	help
	    Represents priority proceeding the range used by sys_init generation at APPLICATION level

config SYS_INIT_GEN_EARLY_PRE
	int
	default 40
	help
	    Represents priority preceeding the range used by sys_init generation at EARLY level

config SYS_INIT_GEN_EARLY_POST
	int
	default 60
	help
	    Represents priority proceeding the range used by sys_init generation at EARLY level

config SYS_INIT_GEN_PRE_KERNEL_1_PRE
	int
	default 40
	help
	    Represents priority preceeding the range used by sys_init generation at PRE_KERNEL_1 level

config SYS_INIT_GEN_PRE_KERNEL_1_POST
	int
	default 60
	help
	    Represents priority proceeding the range used by sys_init generation at PRE_KERNEL_1 level

config SYS_INIT_GEN_PRE_KERNEL_2_PRE
	int
	default 40
	help
	    Represents priority preceeding the range used by sys_init generation at PRE_KERNEL_2 level

config SYS_INIT_GEN_PRE_KERNEL_2_POST
	int
	default 60
	help
	    Represents priority proceeding the range used by sys_init generation at PRE_KERNEL_2 level

config SYS_INIT_GEN_POST_KERNEL_PRE
	int
	default 70
	help
	    Represents priority preceeding the range used by sys_init generation at POST_KERNEL level

config SYS_INIT_GEN_POST_KERNEL_POST
	int
	default 90
	help
	    Represents priority proceeding the range used by sys_init generation at POST_KERNEL level

config SYS_INIT_GEN_SMP_PRE
	int
	default 40
	help
	    Represents priority preceeding the range used by sys_init generation at SMP level

config SYS_INIT_GEN_SMP_POST
	int
	default 60
	help
	    Represents priority proceeding the range used by sys_init generation at SMP level
```
