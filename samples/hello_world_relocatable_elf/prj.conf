## CMakeLists.txt
```
# SPDX-License-Identifier: Apache-2.0

cmake_minimum_required(VERSION 3.28.0)

find_package(Zephyr REQUIRED HINTS $ENV{ZEPHYR_BASE})
project(hello_world_relocatable_elf)

if(DEFINED CONFIG_PIC_OPTIONS)
    zephyr_compile_options(-fPIC -ftls-model=local-exec)
    add_link_options(-pie)
endif()

target_sources(app PRIVATE src/main.c)

# main()'s link-time address is only known after the final link, so patch
# it into main.c's placeholder sentinel bytes once linking is done.
# add_custom_command(TARGET ... POST_BUILD) requires the target to have
# been created in this directory, so depend on it by name instead.
add_custom_command(
  OUTPUT ${CMAKE_CURRENT_BINARY_DIR}/main_link_addr_patched.stamp
  COMMAND ${PYTHON_EXECUTABLE} ${CMAKE_CURRENT_SOURCE_DIR}/patch_main_link_addr.py
          --nm ${CMAKE_NM}
          $<TARGET_FILE:${logical_target_for_zephyr_elf}>
  COMMAND ${CMAKE_COMMAND} -E touch ${CMAKE_CURRENT_BINARY_DIR}/main_link_addr_patched.stamp
  DEPENDS ${logical_target_for_zephyr_elf}
  COMMENT "Patching main() link-time address into $<TARGET_FILE:${logical_target_for_zephyr_elf}>"
  VERBATIM
)
add_custom_target(patch_main_link_addr ALL
  DEPENDS ${CMAKE_CURRENT_BINARY_DIR}/main_link_addr_patched.stamp
)
```

## prj.conf
```kconfig
CONFIG_PIC_OPTIONS=y
CONFIG_QEMU_DEVICE_LOADER=y
```

## src/main.c
```c
/*
 * Copyright (c) Qualcomm Technologies, Inc.
 * SPDX-License-Identifier: Apache-2.0
 */

#include <stdio.h>
#include <stdint.h>
#include <string.h>

/*
 * Patched in place by CMakeLists.txt after the final link, with the
 * address main() was linked at. A self-relocating PIE image only knows
 * where it actually ends up executing at runtime, so this is the only
 * way to recover the link-time address for comparison.
 */
volatile uint8_t main_link_addr_sentinel[8] = {
	0xef, 0xbe, 0xad, 0xde, 0xbe, 0xba, 0xfe, 0xca,
};

int main(void)
{
	uint64_t link_addr;

	memcpy(&link_addr, (void*)main_link_addr_sentinel, sizeof(link_addr));

	printf("Hello World! %s\n", CONFIG_BOARD_TARGET);
	printf("main() linked at:  %#llx\n", (unsigned long long)link_addr);
	printf("main() running at: %#lx\n", (unsigned long)(uintptr_t)&main);

	return 0;
}
```
